## meta-lunnaos/conf/distro/lunnaos.conf
```bitbake
DISTRO = "lunnaos"
DISTRO_NAME = "LunnaOS"
DISTRO_VERSION = "Polaris"
DISTRO_CODENAME = "Sel(l)enne"

DISTRO_FEATURES:append = " systemd wayland opengl pam polkit bluetooth wifi"
DISTRO_FEATURES:remove = " x11"

INIT_MANAGER = "systemd"
VIRTUAL-RUNTIME_init_manager = "systemd"

KERNEL_LOCALVERSION = "-lunnaos"
TARGET_VENDOR = "-lunnaos"
```

## meta-lunnaos/conf/layer.conf
```bitbake
BBPATH .= ":${LAYERDIR}"
BBFILES += "${LAYERDIR}/recipes-*/*/*.bb ${LAYERDIR}/recipes-*/*/*.bbappend"
BBFILE_COLLECTIONS += "lunnaos"
BBFILE_PATTERN_lunnaos = "^${LAYERDIR}/"
BBFILE_PRIORITY_lunnaos = "90"
LAYERSERIES_COMPAT_lunnaos = "scarthgap"
```
